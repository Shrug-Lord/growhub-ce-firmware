## firmware/sdkconfig.defaults
```kconfig
# GrowHub Community Edition — SDK config defaults

# Partition table
CONFIG_PARTITION_TABLE_CUSTOM=y
CONFIG_PARTITION_TABLE_CUSTOM_FILENAME="partitions.csv"

# WiFi
CONFIG_ESP_WIFI_SOFTAP_SUPPORT=y

# MQTT
CONFIG_MQTT_PROTOCOL_311=y
CONFIG_MQTT_TRANSPORT_SSL=n
CONFIG_MQTT_TRANSPORT_WEBSOCKET=n

# HTTP Server
CONFIG_HTTPD_MAX_REQ_HDR_LEN=1024
CONFIG_HTTPD_MAX_URI_LEN=512

# NVS
CONFIG_NVS_ENCRYPTION=n

# SNTP
CONFIG_LWIP_SNTP_MAX_SERVERS=2

# OTA
CONFIG_BOOTLOADER_APP_ROLLBACK_ENABLE=y
CONFIG_OTA_ALLOW_HTTP=y

# JSON (cJSON included in ESP-IDF)
CONFIG_CJSON_NESTING_LIMIT=20

# Flash size — 4MB (matches Niwa hardware)
CONFIG_ESPTOOLPY_FLASHSIZE_4MB=y

# Watchdog — generous for OTA downloads
CONFIG_ESP_TASK_WDT_TIMEOUT_S=30

# Log level
CONFIG_LOG_DEFAULT_LEVEL_INFO=y
```
